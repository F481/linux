## drivers/staging/hswgt/Kconfig
```kconfig
config HSWGT
	tristate "hswgt test driver"
	depends on LEDS_CLASS
	depends on PCI
	---help---
	  Say Y here if you want the HSWGT Test Driver in your kernel.
```
